ASAP2_VERSION 1 41
/begin PROJECT ACC_PC "Generated by ETAS from Project ACC_PC"
/begin HEADER "" VERSION "000" PROJECT_NO ASD /end HEADER
/begin MODULE ACC_PC "Generated by ETAS ASCET7 from Project: ACC_PC"
/begin IF_DATA E_TARGET
 /begin SOURCE "Task0" 3 /* period */ 10 QP_BLOB 1 /end SOURCE
 /begin TP_BLOB /* programm id */ 738210585 /* target id */ 7 0 2 0 /end TP_BLOB
/end IF_DATA
/begin MOD_PAR "" VERSION "000" ADDR_EPK 0x0 EPK "" SUPPLIER "ETAS GmbH" CUSTOMER "xxx" CUSTOMER_NO "000" USER "xxx" PHONE_NO "000" ECU "PC" CPU_TYPE "PCx86" NO_OF_INTERFACES 1 /end MOD_PAR
/begin MOD_COMMON "Common definitions" BYTE_ORDER MSB_LAST ALIGNMENT_BYTE 1 ALIGNMENT_WORD 2 ALIGNMENT_LONG 4 ALIGNMENT_FLOAT32_IEEE 4 ALIGNMENT_FLOAT64_IEEE 8 /end MOD_COMMON
/begin CHARACTERISTIC myCar.myCar.myVehicle.AirFriction "" CURVE 0x436008 STANDARD_CURVE_R64R64 0.0 esdl_ident -1.7976931348623157E+308 1.7976931348623157E+308
 /begin AXIS_DESCR STD_AXIS NO_INPUT_QUANTITY esdl_ident 6 -1.7976931348623157E+308 1.7976931348623157E+308 /end AXIS_DESCR
/end CHARACTERISTIC
/begin CHARACTERISTIC myCar.myCar.myVehicle.BrakeMomentum "" CURVE 0x436070 STANDARD_CURVE_R64R64 0.0 esdl_ident -1.7976931348623157E+308 1.7976931348623157E+308
 /begin AXIS_DESCR STD_AXIS NO_INPUT_QUANTITY esdl_ident 6 -1.7976931348623157E+308 1.7976931348623157E+308 /end AXIS_DESCR
/end CHARACTERISTIC
/begin CHARACTERISTIC myCar.myCar.myVehicle.EngineMomentum "" MAP 0x4360D8 STANDARD_MAP_R64R64R64 0.0 esdl_ident -1.7976931348623157E+308 1.7976931348623157E+308
 /begin AXIS_DESCR STD_AXIS NO_INPUT_QUANTITY esdl_ident 6 -1.7976931348623157E+308 1.7976931348623157E+308 /end AXIS_DESCR
 /begin AXIS_DESCR STD_AXIS NO_INPUT_QUANTITY esdl_ident 6 -1.7976931348623157E+308 1.7976931348623157E+308 /end AXIS_DESCR
/end CHARACTERISTIC
/begin CHARACTERISTIC myCar.myCar.myVehicle.Landscape "" CURVE 0x436260 STANDARD_CURVE_R64R64 0.0 esdl_ident -1.7976931348623157E+308 1.7976931348623157E+308
 /begin AXIS_DESCR STD_AXIS NO_INPUT_QUANTITY esdl_ident 128 -1.7976931348623157E+308 1.7976931348623157E+308 /end AXIS_DESCR
/end CHARACTERISTIC
/begin CHARACTERISTIC myCar.myCar.myVehicle.TrackSize "" VALUE 0x436000 STANDARD_VALUE_R64 0.0 esdl_ident -1.7976931348623157E+308 1.7976931348623157E+308 /end CHARACTERISTIC
/begin CHARACTERISTIC myWork.myDriver.p "" VALUE 0x4550A4 STANDARD_VALUE_R32 0.0 esdl_ident -3.4028234663852886E+38 3.4028234663852886E+38 /end CHARACTERISTIC
/begin CHARACTERISTIC myWork.myDriver.c "" VALUE 0x4550A0 STANDARD_VALUE_R32 0.0 esdl_ident -3.4028234663852886E+38 3.4028234663852886E+38 /end CHARACTERISTIC
/begin MEASUREMENT myCar.myCar.myVehicle.brakebuff "" FLOAT64_IEEE esdl_ident 1 100.0 -1.7976931348623157E+308 1.7976931348623157E+308 ECU_ADDRESS 0x455040 /end MEASUREMENT
/begin MEASUREMENT myCar.myCar.myVehicle.cont "" FLOAT64_IEEE esdl_ident 1 100.0 -1.7976931348623157E+308 1.7976931348623157E+308 ECU_ADDRESS 0x455048 /end MEASUREMENT
/begin MEASUREMENT myCar.myCar.myVehicle.dh "" FLOAT64_IEEE esdl_ident 1 100.0 -1.7976931348623157E+308 1.7976931348623157E+308 ECU_ADDRESS 0x455050 /end MEASUREMENT
/begin MEASUREMENT myCar.myCar.myVehicle.ds "" FLOAT64_IEEE esdl_ident 1 100.0 -1.7976931348623157E+308 1.7976931348623157E+308 ECU_ADDRESS 0x455058 /end MEASUREMENT
/begin MEASUREMENT myCar.myCar.myVehicle.h "" FLOAT64_IEEE esdl_ident 1 100.0 -1.7976931348623157E+308 1.7976931348623157E+308 ECU_ADDRESS 0x455060 /end MEASUREMENT
/begin MEASUREMENT myCar.myCar.myVehicle.lastbrake "" FLOAT64_IEEE esdl_ident 1 100.0 -1.7976931348623157E+308 1.7976931348623157E+308 ECU_ADDRESS 0x455068 /end MEASUREMENT
/begin MEASUREMENT myCar.myCar.myVehicle.momentum "" FLOAT64_IEEE esdl_ident 1 100.0 -1.7976931348623157E+308 1.7976931348623157E+308 ECU_ADDRESS 0x455070 /end MEASUREMENT
/begin MEASUREMENT myCar.myCar.myVehicle.s "" FLOAT64_IEEE esdl_ident 1 100.0 -1.7976931348623157E+308 1.7976931348623157E+308 ECU_ADDRESS 0x455078 /end MEASUREMENT
/begin MEASUREMENT myCar.myCar.myVehicle.v "" FLOAT64_IEEE esdl_ident 1 100.0 -1.7976931348623157E+308 1.7976931348623157E+308 ECU_ADDRESS 0x455080 /end MEASUREMENT
/begin MEASUREMENT myCar.myCar.myVehicle.accel "" FLOAT32_IEEE esdl_ident 1 100.0 -3.4028234663852886E+38 3.4028234663852886E+38 ECU_ADDRESS 0x455088 /end MEASUREMENT
/begin MEASUREMENT resources.CarMessages.v "" FLOAT32_IEEE esdl_ident 1 100.0 -3.4028234663852886E+38 3.4028234663852886E+38 ECU_ADDRESS 0x4550E4 /end MEASUREMENT
/begin MEASUREMENT resources.CarMessages.acceleration "" FLOAT32_IEEE esdl_ident 1 100.0 -3.4028234663852886E+38 3.4028234663852886E+38 ECU_ADDRESS 0x4550E8 /end MEASUREMENT
/begin MEASUREMENT resources.PassThroughMessages.gas "" FLOAT32_IEEE esdl_ident 1 100.0 -3.4028234663852886E+38 3.4028234663852886E+38 ECU_ADDRESS 0x455100 /end MEASUREMENT
/begin MEASUREMENT resources.PassThroughMessages.brake "" FLOAT32_IEEE esdl_ident 1 100.0 -3.4028234663852886E+38 3.4028234663852886E+38 ECU_ADDRESS 0x455104 /end MEASUREMENT
/begin MEASUREMENT resources.DriverMessages.powerDriver "" FLOAT32_IEEE esdl_ident 1 100.0 -3.4028234663852886E+38 3.4028234663852886E+38 ECU_ADDRESS 0x4550F8 /end MEASUREMENT
/begin MEASUREMENT resources.DriverMessages.brakeDriver "" FLOAT32_IEEE esdl_ident 1 100.0 -3.4028234663852886E+38 3.4028234663852886E+38 ECU_ADDRESS 0x4550FC /end MEASUREMENT
/begin MEASUREMENT resources.DriverMessages.onButtonPressed "" UBYTE esdl_ident 1 100.0 0 1 ECU_ADDRESS 0x4550F4 BIT_MASK 0x1 /end MEASUREMENT
/begin MEASUREMENT resources.DriverMessages.offButtonPressed "" UBYTE esdl_ident 1 100.0 0 1 ECU_ADDRESS 0x4550F5 BIT_MASK 0x1 /end MEASUREMENT
/begin MEASUREMENT resources.DriverMessages.increaseSpeed "" UBYTE esdl_ident 1 100.0 0 1 ECU_ADDRESS 0x4550F6 BIT_MASK 0x1 /end MEASUREMENT
/begin MEASUREMENT resources.DriverMessages.decreaseSpeed "" UBYTE esdl_ident 1 100.0 0 1 ECU_ADDRESS 0x4550F7 BIT_MASK 0x1 /end MEASUREMENT
/begin MEASUREMENT myWork.myDriver.flag "" UBYTE esdl_ident 1 100.0 0 1 ECU_ADDRESS 0x436A8C BIT_MASK 0x1 /end MEASUREMENT
/begin MEASUREMENT myWork.myDriver.increaseCounter "" SLONG esdl_ident 1 100.0 -2147483648 2147483647 ECU_ADDRESS 0x436A80 /end MEASUREMENT
/begin MEASUREMENT myWork.myDriver.increaseCounter2 "" SLONG esdl_ident 1 100.0 -2147483648 2147483647 ECU_ADDRESS 0x436A84 /end MEASUREMENT
/begin MEASUREMENT myWork.myDriver.time "" FLOAT32_IEEE esdl_ident 1 100.0 -3.4028234663852886E+38 3.4028234663852886E+38 ECU_ADDRESS 0x436A88 /end MEASUREMENT
/begin MEASUREMENT myWork.myDriver.StopWatch_instance.time "" FLOAT32_IEEE esdl_ident 1 100.0 -3.4028234663852886E+38 3.4028234663852886E+38 ECU_ADDRESS 0x436A90 /end MEASUREMENT
/begin MEASUREMENT resources.TargetMessages.targetVelocity "" FLOAT32_IEEE esdl_ident 1 100.0 -3.4028234663852886E+38 3.4028234663852886E+38 ECU_ADDRESS 0x45510C /end MEASUREMENT
/begin MEASUREMENT myWork.StateHandlerBD.StateHandler_instance.sm "" UBYTE esdl_myWork_StateHandlerStatemachineStates 1 100.0 0 2 ECU_ADDRESS 0x4550CE /end MEASUREMENT
/begin MEASUREMENT myWork.StateHandlerBD.StateHandler_instance.status "" SLONG esdl_ident 1 100.0 -2147483648 2147483647 ECU_ADDRESS 0x4550C8 /end MEASUREMENT
/begin MEASUREMENT myWork.StateHandlerBD.StateHandler_instance.onButtonPressed "" UBYTE esdl_ident 1 100.0 0 1 ECU_ADDRESS 0x4550CD BIT_MASK 0x1 /end MEASUREMENT
/begin MEASUREMENT myWork.StateHandlerBD.StateHandler_instance.offButtonPressed "" UBYTE esdl_ident 1 100.0 0 1 ECU_ADDRESS 0x4550CC BIT_MASK 0x1 /end MEASUREMENT
/begin MEASUREMENT myWork.StateHandlerBD.StateHandler_instance.powerDriver "" FLOAT32_IEEE esdl_ident 1 100.0 -3.4028234663852886E+38 3.4028234663852886E+38 ECU_ADDRESS 0x4550C4 /end MEASUREMENT
/begin MEASUREMENT myWork.StateHandlerBD.StateHandler_instance.brakeDriver "" FLOAT32_IEEE esdl_ident 1 100.0 -3.4028234663852886E+38 3.4028234663852886E+38 ECU_ADDRESS 0x4550C0 /end MEASUREMENT
/begin MEASUREMENT myWork.StateHandlerBD.StateHandler_instance_2.sm "" UBYTE esdl_myWork_StateHandlerStatemachineStates 1 100.0 0 2 ECU_ADDRESS 0x4550DE /end MEASUREMENT
/begin MEASUREMENT myWork.StateHandlerBD.StateHandler_instance_2.status "" SLONG esdl_ident 1 100.0 -2147483648 2147483647 ECU_ADDRESS 0x4550D8 /end MEASUREMENT
/begin MEASUREMENT myWork.StateHandlerBD.StateHandler_instance_2.onButtonPressed "" UBYTE esdl_ident 1 100.0 0 1 ECU_ADDRESS 0x4550DD BIT_MASK 0x1 /end MEASUREMENT
/begin MEASUREMENT myWork.StateHandlerBD.StateHandler_instance_2.offButtonPressed "" UBYTE esdl_ident 1 100.0 0 1 ECU_ADDRESS 0x4550DC BIT_MASK 0x1 /end MEASUREMENT
/begin MEASUREMENT myWork.StateHandlerBD.StateHandler_instance_2.powerDriver "" FLOAT32_IEEE esdl_ident 1 100.0 -3.4028234663852886E+38 3.4028234663852886E+38 ECU_ADDRESS 0x4550D4 /end MEASUREMENT
/begin MEASUREMENT myWork.StateHandlerBD.StateHandler_instance_2.brakeDriver "" FLOAT32_IEEE esdl_ident 1 100.0 -3.4028234663852886E+38 3.4028234663852886E+38 ECU_ADDRESS 0x4550D0 /end MEASUREMENT
/begin MEASUREMENT resources.StateHandlerMessages.status "" SLONG esdl_ident 1 100.0 -2147483648 2147483647 ECU_ADDRESS 0x455108 /end MEASUREMENT
/begin MEASUREMENT myWork.Target.targetInstance.targetVelocity "" FLOAT32_IEEE esdl_ident 1 100.0 -3.4028234663852886E+38 3.4028234663852886E+38 ECU_ADDRESS 0x4550E0 /end MEASUREMENT
/begin MEASUREMENT myWork.PassThrough.psinstance.gas "" FLOAT32_IEEE esdl_ident 1 100.0 -3.4028234663852886E+38 3.4028234663852886E+38 ECU_ADDRESS 0x4550AC /end MEASUREMENT
/begin MEASUREMENT myWork.PassThrough.psinstance.brake "" FLOAT32_IEEE esdl_ident 1 100.0 -3.4028234663852886E+38 3.4028234663852886E+38 ECU_ADDRESS 0x4550A8 /end MEASUREMENT
/begin MEASUREMENT resources.ControllerMessages.gas "" FLOAT32_IEEE esdl_ident 1 100.0 -3.4028234663852886E+38 3.4028234663852886E+38 ECU_ADDRESS 0x4550EC /end MEASUREMENT
/begin MEASUREMENT resources.ControllerMessages.brake "" FLOAT32_IEEE esdl_ident 1 100.0 -3.4028234663852886E+38 3.4028234663852886E+38 ECU_ADDRESS 0x4550F0 /end MEASUREMENT
/begin COMPU_METHOD esdl_ident "" RAT_FUNC /* format */ "%12.4" /* unit */ "" /* coeffs */ COEFFS 0 1 0 0 0 1 /end COMPU_METHOD
/begin COMPU_METHOD esdl_myWork_StateHandlerStatemachineStates "" TAB_VERB /* format */ "%12.4" /* unit */ "" /* compu_tab_ref */ COMPU_TAB_REF esdl_myWork_StateHandlerStatemachineStates_vtab /end COMPU_METHOD
/begin COMPU_VTAB esdl_myWork_StateHandlerStatemachineStates_vtab "" TAB_VERB /* number value pairs */ 3 1 "on" 0 "off" 2 "passive" /* default value */ DEFAULT_VALUE "Error" /end COMPU_VTAB
/begin FUNCTION ACC_PC ""
 /begin SUB_FUNCTION myCar.myCar myWork.myACC myWork.myDriver myWork.StateHandlerBD myWork.Target myWork.PassThrough myWork.Controller resources.TimeTick /end SUB_FUNCTION
/end FUNCTION
/begin FUNCTION myCar.myCar ""
 /begin IN_MEASUREMENT resources.PassThroughMessages.brake resources.PassThroughMessages.gas /end IN_MEASUREMENT
 /begin OUT_MEASUREMENT resources.CarMessages.acceleration resources.CarMessages.v /end OUT_MEASUREMENT
 /begin SUB_FUNCTION myCar.myCar.myVehicle /end SUB_FUNCTION
/end FUNCTION
/begin FUNCTION myCar.myCar.myVehicle ""
 /begin DEF_CHARACTERISTIC myCar.myCar.myVehicle.AirFriction myCar.myCar.myVehicle.BrakeMomentum myCar.myCar.myVehicle.EngineMomentum myCar.myCar.myVehicle.Landscape myCar.myCar.myVehicle.TrackSize /end DEF_CHARACTERISTIC
 /begin LOC_MEASUREMENT myCar.myCar.myVehicle.accel myCar.myCar.myVehicle.brakebuff myCar.myCar.myVehicle.cont myCar.myCar.myVehicle.dh myCar.myCar.myVehicle.ds myCar.myCar.myVehicle.h myCar.myCar.myVehicle.lastbrake myCar.myCar.myVehicle.momentum myCar.myCar.myVehicle.s myCar.myCar.myVehicle.v /end LOC_MEASUREMENT
/end FUNCTION
/begin FUNCTION myWork.myACC ""
 /begin IN_MEASUREMENT resources.DriverMessages.brakeDriver resources.DriverMessages.powerDriver /end IN_MEASUREMENT
 /begin OUT_MEASUREMENT resources.PassThroughMessages.brake resources.PassThroughMessages.gas /end OUT_MEASUREMENT
/end FUNCTION
/begin FUNCTION myWork.myDriver "" /begin DEF_CHARACTERISTIC myWork.myDriver.p myWork.myDriver.c /end DEF_CHARACTERISTIC
 /begin IN_MEASUREMENT resources.CarMessages.v resources.TargetMessages.targetVelocity /end IN_MEASUREMENT
 /begin OUT_MEASUREMENT resources.DriverMessages.brakeDriver resources.DriverMessages.decreaseSpeed resources.DriverMessages.increaseSpeed resources.DriverMessages.onButtonPressed resources.DriverMessages.powerDriver /end OUT_MEASUREMENT
 /begin LOC_MEASUREMENT myWork.myDriver.flag myWork.myDriver.increaseCounter myWork.myDriver.increaseCounter2 myWork.myDriver.time /end LOC_MEASUREMENT
 /begin SUB_FUNCTION myWork.myDriver.StopWatch_instance /end SUB_FUNCTION
/end FUNCTION
/begin FUNCTION myWork.myDriver.StopWatch_instance "" /begin LOC_MEASUREMENT myWork.myDriver.StopWatch_instance.time /end LOC_MEASUREMENT /end FUNCTION
/begin FUNCTION myWork.StateHandlerBD ""
 /begin IN_MEASUREMENT resources.DriverMessages.brakeDriver resources.DriverMessages.offButtonPressed resources.DriverMessages.onButtonPressed resources.DriverMessages.powerDriver /end IN_MEASUREMENT
 /begin OUT_MEASUREMENT resources.StateHandlerMessages.status /end OUT_MEASUREMENT
 /begin SUB_FUNCTION myWork.StateHandlerBD.StateHandler_instance myWork.StateHandlerBD.StateHandler_instance_2 /end SUB_FUNCTION
/end FUNCTION
/begin FUNCTION myWork.StateHandlerBD.StateHandler_instance ""
 /begin LOC_MEASUREMENT myWork.StateHandlerBD.StateHandler_instance.brakeDriver myWork.StateHandlerBD.StateHandler_instance.offButtonPressed myWork.StateHandlerBD.StateHandler_instance.onButtonPressed myWork.StateHandlerBD.StateHandler_instance.powerDriver myWork.StateHandlerBD.StateHandler_instance.sm myWork.StateHandlerBD.StateHandler_instance.status /end LOC_MEASUREMENT
/end FUNCTION
/begin FUNCTION myWork.StateHandlerBD.StateHandler_instance_2 ""
 /begin LOC_MEASUREMENT myWork.StateHandlerBD.StateHandler_instance_2.brakeDriver myWork.StateHandlerBD.StateHandler_instance_2.offButtonPressed myWork.StateHandlerBD.StateHandler_instance_2.onButtonPressed myWork.StateHandlerBD.StateHandler_instance_2.powerDriver myWork.StateHandlerBD.StateHandler_instance_2.sm myWork.StateHandlerBD.StateHandler_instance_2.status /end LOC_MEASUREMENT
/end FUNCTION
/begin FUNCTION myWork.Target ""
 /begin IN_MEASUREMENT resources.CarMessages.v resources.DriverMessages.decreaseSpeed resources.DriverMessages.increaseSpeed resources.StateHandlerMessages.status /end IN_MEASUREMENT
 /begin OUT_MEASUREMENT resources.TargetMessages.targetVelocity /end OUT_MEASUREMENT
 /begin SUB_FUNCTION myWork.Target.targetInstance /end SUB_FUNCTION
/end FUNCTION
/begin FUNCTION myWork.Target.targetInstance "" /begin LOC_MEASUREMENT myWork.Target.targetInstance.targetVelocity /end LOC_MEASUREMENT /end FUNCTION
/begin FUNCTION myWork.PassThrough ""
 /begin IN_MEASUREMENT resources.ControllerMessages.brake resources.ControllerMessages.gas resources.DriverMessages.brakeDriver resources.DriverMessages.powerDriver resources.StateHandlerMessages.status /end IN_MEASUREMENT
 /begin OUT_MEASUREMENT resources.PassThroughMessages.brake resources.PassThroughMessages.gas /end OUT_MEASUREMENT
 /begin SUB_FUNCTION myWork.PassThrough.psinstance /end SUB_FUNCTION
/end FUNCTION
/begin FUNCTION myWork.PassThrough.psinstance ""
 /begin LOC_MEASUREMENT myWork.PassThrough.psinstance.brake myWork.PassThrough.psinstance.gas /end LOC_MEASUREMENT
/end FUNCTION
/begin FUNCTION myWork.Controller ""
 /begin IN_MEASUREMENT resources.CarMessages.acceleration resources.CarMessages.v resources.TargetMessages.targetVelocity /end IN_MEASUREMENT
 /begin OUT_MEASUREMENT resources.ControllerMessages.brake resources.ControllerMessages.gas /end OUT_MEASUREMENT
/end FUNCTION
/begin FUNCTION resources.TimeTick "" /end FUNCTION
/begin RECORD_LAYOUT STANDARD_CURVE_R64R64 /* axis size */ NO_AXIS_PTS_X 1 UWORD /* axis */ AXIS_PTS_X 2 FLOAT64_IEEE INDEX_INCR DIRECT FNC_VALUES 3 FLOAT64_IEEE COLUMN_DIR DIRECT /end RECORD_LAYOUT
/begin RECORD_LAYOUT STANDARD_MAP_R64R64R64 /* x axis size */ NO_AXIS_PTS_X 1 UWORD /* y axis size */ NO_AXIS_PTS_Y 2 UWORD /* x axis */ AXIS_PTS_X 3 FLOAT64_IEEE INDEX_INCR DIRECT /* y axis */ AXIS_PTS_Y 4 FLOAT64_IEEE INDEX_INCR DIRECT FNC_VALUES 5 FLOAT64_IEEE COLUMN_DIR DIRECT /end RECORD_LAYOUT
/begin RECORD_LAYOUT STANDARD_VALUE_R64 FNC_VALUES 1 FLOAT64_IEEE COLUMN_DIR DIRECT /end RECORD_LAYOUT
/begin RECORD_LAYOUT STANDARD_VALUE_R32 FNC_VALUES 1 FLOAT32_IEEE COLUMN_DIR DIRECT /end RECORD_LAYOUT
/begin GROUP ACC_PC "" ROOT
 /begin SUB_GROUP myCar.myCar resources.CarMessages resources.PassThroughMessages myWork.myACC resources.DriverMessages myWork.myDriver resources.TargetMessages myWork.StateHandlerBD resources.StateHandlerMessages myWork.Target myWork.PassThrough resources.ControllerMessages myWork.Controller resources.TimeTick /end SUB_GROUP
/end GROUP
/begin GROUP myCar.myCar "" /begin SUB_GROUP myCar.myCar.myVehicle /end SUB_GROUP /end GROUP
/begin GROUP myCar.myCar.myVehicle ""
 /begin REF_CHARACTERISTIC myCar.myCar.myVehicle.AirFriction myCar.myCar.myVehicle.BrakeMomentum myCar.myCar.myVehicle.EngineMomentum myCar.myCar.myVehicle.Landscape myCar.myCar.myVehicle.TrackSize /end REF_CHARACTERISTIC
 /begin REF_MEASUREMENT myCar.myCar.myVehicle.accel myCar.myCar.myVehicle.brakebuff myCar.myCar.myVehicle.cont myCar.myCar.myVehicle.dh myCar.myCar.myVehicle.ds myCar.myCar.myVehicle.h myCar.myCar.myVehicle.lastbrake myCar.myCar.myVehicle.momentum myCar.myCar.myVehicle.s myCar.myCar.myVehicle.v /end REF_MEASUREMENT
/end GROUP
/begin GROUP resources.CarMessages "" /begin REF_MEASUREMENT resources.CarMessages.acceleration resources.CarMessages.v /end REF_MEASUREMENT /end GROUP
/begin GROUP resources.PassThroughMessages ""
 /begin REF_MEASUREMENT resources.PassThroughMessages.brake resources.PassThroughMessages.gas /end REF_MEASUREMENT
/end GROUP
/begin GROUP myWork.myACC "" /end GROUP
/begin GROUP resources.DriverMessages ""
 /begin REF_MEASUREMENT resources.DriverMessages.brakeDriver resources.DriverMessages.decreaseSpeed resources.DriverMessages.increaseSpeed resources.DriverMessages.offButtonPressed resources.DriverMessages.onButtonPressed resources.DriverMessages.powerDriver /end REF_MEASUREMENT
/end GROUP
/begin GROUP myWork.myDriver "" /begin REF_CHARACTERISTIC myWork.myDriver.p myWork.myDriver.c /end REF_CHARACTERISTIC
 /begin REF_MEASUREMENT myWork.myDriver.flag myWork.myDriver.increaseCounter myWork.myDriver.increaseCounter2 myWork.myDriver.time /end REF_MEASUREMENT
 /begin SUB_GROUP myWork.myDriver.StopWatch_instance /end SUB_GROUP
/end GROUP
/begin GROUP myWork.myDriver.StopWatch_instance "" /begin REF_MEASUREMENT myWork.myDriver.StopWatch_instance.time /end REF_MEASUREMENT /end GROUP
/begin GROUP resources.TargetMessages "" /begin REF_MEASUREMENT resources.TargetMessages.targetVelocity /end REF_MEASUREMENT /end GROUP
/begin GROUP myWork.StateHandlerBD ""
 /begin SUB_GROUP myWork.StateHandlerBD.StateHandler_instance myWork.StateHandlerBD.StateHandler_instance_2 /end SUB_GROUP
/end GROUP
/begin GROUP myWork.StateHandlerBD.StateHandler_instance ""
 /begin REF_MEASUREMENT myWork.StateHandlerBD.StateHandler_instance.brakeDriver myWork.StateHandlerBD.StateHandler_instance.offButtonPressed myWork.StateHandlerBD.StateHandler_instance.onButtonPressed myWork.StateHandlerBD.StateHandler_instance.powerDriver myWork.StateHandlerBD.StateHandler_instance.sm myWork.StateHandlerBD.StateHandler_instance.status /end REF_MEASUREMENT
/end GROUP
/begin GROUP myWork.StateHandlerBD.StateHandler_instance_2 ""
 /begin REF_MEASUREMENT myWork.StateHandlerBD.StateHandler_instance_2.brakeDriver myWork.StateHandlerBD.StateHandler_instance_2.offButtonPressed myWork.StateHandlerBD.StateHandler_instance_2.onButtonPressed myWork.StateHandlerBD.StateHandler_instance_2.powerDriver myWork.StateHandlerBD.StateHandler_instance_2.sm myWork.StateHandlerBD.StateHandler_instance_2.status /end REF_MEASUREMENT
/end GROUP
/begin GROUP resources.StateHandlerMessages "" /begin REF_MEASUREMENT resources.StateHandlerMessages.status /end REF_MEASUREMENT /end GROUP
/begin GROUP myWork.Target "" /begin SUB_GROUP myWork.Target.targetInstance /end SUB_GROUP /end GROUP
/begin GROUP myWork.Target.targetInstance "" /begin REF_MEASUREMENT myWork.Target.targetInstance.targetVelocity /end REF_MEASUREMENT /end GROUP
/begin GROUP myWork.PassThrough "" /begin SUB_GROUP myWork.PassThrough.psinstance /end SUB_GROUP /end GROUP
/begin GROUP myWork.PassThrough.psinstance ""
 /begin REF_MEASUREMENT myWork.PassThrough.psinstance.brake myWork.PassThrough.psinstance.gas /end REF_MEASUREMENT
/end GROUP
/begin GROUP resources.ControllerMessages ""
 /begin REF_MEASUREMENT resources.ControllerMessages.brake resources.ControllerMessages.gas /end REF_MEASUREMENT
/end GROUP
/begin GROUP myWork.Controller "" /end GROUP
/begin GROUP resources.TimeTick "" /end GROUP
/end MODULE
/end PROJECT
